## boards/shields/totem_tp/Kconfig.defconfig
```kconfig
# Copyright (c) 2022 The ZMK Contributors
# SPDX-License-Identifier: MIT

if SHIELD_TOTEM_TP_DONGLE

config ZMK_KEYBOARD_NAME
    default "TOTEM"
    
config ZMK_SPLIT_ROLE_CENTRAL
    default y

config ZMK_USB
    default y

endif

if SHIELD_TOTEM_TP_LEFT || SHIELD_TOTEM_TP_RIGHT || SHIELD_TOTEM_TP_DONGLE

config ZMK_SPLIT
    default y

config ZMK_BLE
    default y

endif
```

## boards/shields/totem_tp/Kconfig.shield
```kconfig
# Copyright (c) 2023 The ZMK Contributors
# SPDX-License-Identifier: MIT

config SHIELD_TOTEM_TP_LEFT
	def_bool $(shields_list_contains,totem_left)

config SHIELD_TOTEM_TP_RIGHT
	def_bool $(shields_list_contains,totem_right)

config SHIELD_TOTEM_TP_DONGLE
	def_bool $(shields_list_contains,totem_dongle)
```
